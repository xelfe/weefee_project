## espidf/weefee_esp32/main/Kconfig.projbuild
```kconfig
menu "Weefee Configuration"

    menu "micro-ROS Settings"
        config MICRO_ROS_APP_STACK
            int "Stack the micro-ROS app (Bytes)"
            default 16000
            help
                Stack size in Bytes of the micro-ROS app

        config MICRO_ROS_APP_TASK_PRIO
            int "Priority of the micro-ROS app"
            default 18
            help
                Priority of micro-ros task higher value means higher priority
    endmenu

    menu "Robot Physical Dimensions"
        config ROBOT_BODY_LENGTH
            int "Robot Body Length (mm)"
            default 170
            help
                Length of the robot body in millimeters.

        config ROBOT_BODY_WIDTH
            int "Robot Body Width (mm)"
            default 80
            help
                Width of the robot body in millimeters.

        menu "Leg Segment Lengths"
            config DEFAULT_COXA_LENGTH
                int "Default Coxa Length (mm)"
                default 30
                help
                    Default length of the coxa (first leg segment) in millimeters.

            config DEFAULT_FEMUR_LENGTH
                int "Default Femur Length (mm)"
                default 50
                help
                    Default length of the femur (second leg segment) in millimeters.

            config DEFAULT_TIBIA_LENGTH
                int "Default Tibia Length (mm)"
                default 60
                help
                    Default length of the tibia (third leg segment) in millimeters.
        endmenu
    endmenu

    menu "Servo Configuration"
        menu "PWM Parameters"
            config SERVO_MIN_PULSEWIDTH
                int "Minimum Servo Pulse Width (us)"
                default 500
                range 500 1500
                help
                    Minimum pulse width in microseconds for servo control (0 degrees)

            config SERVO_MAX_PULSEWIDTH
                int "Maximum Servo Pulse Width (us)"
                default 2500
                range 1500 2500
                help
                    Maximum pulse width in microseconds for servo control (180 degrees)

            config SERVO_FREQ
                int "Servo PWM Frequency (Hz)"
                default 50
                range 50 330
                help
                    Frequency in Hz for servo PWM signal
        endmenu

        menu "Front Right Leg Pins"
            config SERVO_PIN_0
                int "Coxa Servo Pin"
                default 16
                range 0 33
                help
                    GPIO pin number for Front Right leg coxa servo

            config SERVO_PIN_1
                int "Femur Servo Pin"
                default 18
                range 0 33
                help
                    GPIO pin number for Front Right leg femur servo

            config SERVO_PIN_2
                int "Tibia Servo Pin" 
                default 17
                range 0 33
                help
                    GPIO pin number for Front Right leg tibia servo
        endmenu

        menu "Front Left Leg Pins"
            config SERVO_PIN_3
                int "Coxa Servo Pin"
                default 25
                range 0 33
                help
                    GPIO pin number for Front Left leg coxa servo

            config SERVO_PIN_4
                int "Femur Servo Pin"
                default 26
                range 0 33
                help
                    GPIO pin number for Front Left leg femur servo

            config SERVO_PIN_5
                int "Tibia Servo Pin"
                default 27
                range 0 33
                help
                    GPIO pin number for Front Left leg tibia servo
        endmenu

        menu "Rear Right Leg Pins"
            config SERVO_PIN_6
                int "Coxa Servo Pin"
                default 4
                range 0 33
                help
                    GPIO pin number for Rear Right leg coxa servo

            config SERVO_PIN_7
                int "Femur Servo Pin"
                default 2
                range 0 33
                help
                    GPIO pin number for Rear Right leg femur servo

            config SERVO_PIN_8
                int "Tibia Servo Pin"
                default 15
                range 0 33
                help
                    GPIO pin number for Rear Right leg tibia servo
        endmenu

        menu "Rear Left Leg Pins"
            config SERVO_PIN_9
                int "Coxa Servo Pin"
                default 13
                range 0 33
                help
                    GPIO pin number for Rear Left leg coxa servo

            config SERVO_PIN_10
                int "Femur Servo Pin"
                default 12
                range 0 33
                help
                    GPIO pin number for Rear Left leg femur servo

            config SERVO_PIN_11
                int "Tibia Servo Pin"
                default 14
                range 0 33
                help
                    GPIO pin number for Rear Left leg tibia servo
        endmenu
    endmenu

    menu "Battery Monitor Configuration"
        config BAT_MONITOR_ENABLED
            bool "Enable Battery Monitoring"
            default y
            help
                Enable or disable battery monitoring using INA219 sensor.

        config BAT_MONITOR_SDA_PIN
            int "I2C SDA Pin for INA219"
            default 21
            range 0 33
            depends on BAT_MONITOR_ENABLED
            help
                GPIO pin number for I2C SDA line connected to INA219.

        config BAT_MONITOR_SCL_PIN
            int "I2C SCL Pin for INA219"
            default 22
            range 0 33
            depends on BAT_MONITOR_ENABLED
            help
                GPIO pin number for I2C SCL line connected to INA219.

        config BAT_MONITOR_I2C_FREQ
            int "I2C Frequency (Hz)"
            default 100000
            range 50000 400000
            depends on BAT_MONITOR_ENABLED
            help
                I2C frequency in Hz for communication with INA219.

        config BAT_MONITOR_UPDATE_INTERVAL
            int "Battery Status Update Interval (ms)"
            default 5000
            range 1000 60000
            depends on BAT_MONITOR_ENABLED
            help
                Interval in milliseconds between battery status updates.

        config BAT_MONITOR_CELL_COUNT
            int "LiPo Battery Cell Count"
            default 2
            range 1 6
            depends on BAT_MONITOR_ENABLED
            help
                Number of cells in your LiPo battery (1S to 6S).
                This will be used to calculate voltage thresholds automatically.

        config BAT_MONITOR_CELL_LOW_PCT
            int "Low Battery Percentage"
            default 30
            range 10 50
            depends on BAT_MONITOR_ENABLED
            help
                Percentage at which to trigger low battery warning (typically 30%).

        config BAT_MONITOR_CELL_CRITICAL_PCT
            int "Critical Battery Percentage"
            default 15
            range 5 25
            depends on BAT_MONITOR_ENABLED
            help
                Percentage at which to trigger critical battery warning (typically 15%).

        config BAT_MONITOR_LOW_THRESHOLD
            int "Low Battery Threshold (V x10) [DEPRECATED]"
            default 74
            depends on BAT_MONITOR_ENABLED
            help
                Deprecated. Use the cell-based settings above instead.
                This setting will be removed in future versions.

        config BAT_MONITOR_CRITICAL_THRESHOLD
            int "Critical Battery Threshold (V x10) [DEPRECATED]"
            default 68
            depends on BAT_MONITOR_ENABLED
            help
                Deprecated. Use the cell-based settings above instead.
                This setting will be removed in future versions.
    endmenu

    menu "System Monitoring Test"
        config SYSTEM_MONITOR_TEST_ENABLED
            bool "Enable System Monitoring Test"
            default n
            help
                Enable this option to run a system monitoring test at startup.
                This will test memory and CPU monitoring with simulated loads.
                Disable for normal operation.
    endmenu

endmenu
```

## espidf/weefee_esp32/sdkconfig.defaults
```kconfig
# Optimisation de la fréquence CPU
CONFIG_ESP_DEFAULT_CPU_FREQ_MHZ=240

# Désactiver Bluetooth pour économiser de la RAM et du CPU
CONFIG_BT_ENABLED=n
CONFIG_BT_BLUEDROID_ENABLED=n
CONFIG_BTDM_CTRL_MODE_BLE_ONLY=n
CONFIG_BTDM_CTRL_MODE_BR_EDR_ONLY=n
CONFIG_BTDM_CTRL_MODE_BTDM=n

# Optimiser la gestion d'énergie pour de meilleures performances
CONFIG_PM_ENABLE=y
CONFIG_PM_DFS_INIT_AUTO=n
CONFIG_PM_SLP_DISABLE_GPIO=n
CONFIG_PM_SLP_IRAM_OPT=y
CONFIG_PM_RTOS_IDLE_OPT=y

# Optimisations WiFi pour réduire l'impact CPU
CONFIG_ESP_WIFI_IRAM_OPT=y
CONFIG_ESP_WIFI_RX_IRAM_OPT=y
CONFIG_ESP_WIFI_SLP_IRAM_OPT=y
CONFIG_ESP_WIFI_EXTRA_IRAM_OPT=y
CONFIG_ESP32_WIFI_SW_COEXIST_ENABLE=n
CONFIG_ESP32_WIFI_STATIC_RX_BUFFER_NUM=16
CONFIG_ESP32_WIFI_DYNAMIC_RX_BUFFER_NUM=64
CONFIG_ESP32_WIFI_DYNAMIC_TX_BUFFER_NUM=64
CONFIG_ESP32_WIFI_TX_BA_WIN=16
CONFIG_ESP32_WIFI_RX_BA_WIN=16
CONFIG_ESP32_WIFI_TASK_PINNED_TO_CORE_0=y
CONFIG_ESP32_WIFI_IRAM_OPT=y
CONFIG_ESP32_WIFI_MGMT_SBUF_NUM=32

# Optimizations for micro-ROS
CONFIG_MICRO_ROS_APP_STACK=16000
CONFIG_MICRO_ROS_APP_TASK_PRIO=18

# System optimizations
CONFIG_ESP_MAIN_TASK_STACK_SIZE=8192
CONFIG_ESP_TIMER_TASK_STACK_SIZE=4096
CONFIG_ESP_SYSTEM_EVENT_TASK_STACK_SIZE=4096
CONFIG_ESP_MINIMAL_SHARED_STACK_SIZE=2048
CONFIG_FREERTOS_HZ=1000
CONFIG_FREERTOS_USE_TICKLESS_IDLE=y

# Compilation optimizations
CONFIG_COMPILER_OPTIMIZATION_SIZE=y
CONFIG_COMPILER_OPTIMIZATION_ASSERTIONS_ENABLE=y

# Servo pins configuration
CONFIG_SERVO_PIN_0=16
CONFIG_SERVO_PIN_1=18
CONFIG_SERVO_PIN_2=17
CONFIG_SERVO_PIN_3=25
CONFIG_SERVO_PIN_4=26
CONFIG_SERVO_PIN_5=27
CONFIG_SERVO_PIN_6=4
CONFIG_SERVO_PIN_7=2
CONFIG_SERVO_PIN_8=15
CONFIG_SERVO_PIN_9=13
CONFIG_SERVO_PIN_10=12
CONFIG_SERVO_PIN_11=14

# Robot dimensions
CONFIG_ROBOT_BODY_LENGTH=170
CONFIG_ROBOT_BODY_WIDTH=80

# Leg segments dimensions
CONFIG_DEFAULT_COXA_LENGTH=30
CONFIG_DEFAULT_FEMUR_LENGTH=50
CONFIG_DEFAULT_TIBIA_LENGTH=60

# Paramètres PWM des servos
CONFIG_SERVO_MIN_PULSEWIDTH=500
CONFIG_SERVO_MAX_PULSEWIDTH=2500
CONFIG_SERVO_FREQ=50

# Configuration du moniteur de batterie
CONFIG_BAT_MONITOR_ENABLED=y
CONFIG_BAT_MONITOR_SDA_PIN=21
CONFIG_BAT_MONITOR_SCL_PIN=22
CONFIG_BAT_MONITOR_I2C_FREQ=100000
CONFIG_BAT_MONITOR_UPDATE_INTERVAL=5000
CONFIG_BAT_MONITOR_CELL_COUNT=2
CONFIG_BAT_MONITOR_CELL_LOW_PCT=30
CONFIG_BAT_MONITOR_CELL_CRITICAL_PCT=15
```
